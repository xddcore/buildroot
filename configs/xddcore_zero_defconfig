## configs/xddcore_zero_defconfig
```kconfig
BR2_arm=y
BR2_KERNEL_HEADERS_6_1=y
BR2_TOOLCHAIN_BUILDROOT_CXX=y
BR2_TOOLCHAIN_BUILDROOT_FORTRAN=y
BR2_TOOLCHAIN_BUILDROOT_DLANG=y
BR2_GCC_ENABLE_OPENMP=y
BR2_GCC_ENABLE_GRAPHITE=y
BR2_SHARED_STATIC_LIBS=y
BR2_TARGET_GENERIC_HOSTNAME="xddcore"
BR2_TARGET_GENERIC_ISSUE="Welcome to Xddcore Zero Linux Board"
BR2_TARGET_GENERIC_ROOT_PASSWD="123456"
BR2_TARGET_TZ_INFO=y
BR2_PACKAGE_LTRIS=y
BR2_PACKAGE_ZSH=y
```
